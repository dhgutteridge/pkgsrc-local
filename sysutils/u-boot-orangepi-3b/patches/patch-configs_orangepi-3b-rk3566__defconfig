## sysutils/u-boot-orangepi-3b/patches/patch-configs_orangepi-3b-rk3566__defconfig
```kconfig
$NetBSD$

Load u-boot from 256KB.

--- configs/orangepi-3b-rk3566_defconfig.orig	2024-10-07 10:54:35.000000000 -0400
+++ configs/orangepi-3b-rk3566_defconfig
@@ -2,6 +2,7 @@
 CONFIG_SKIP_LOWLEVEL_INIT=y
 CONFIG_COUNTER_FREQUENCY=24000000
 CONFIG_ARCH_ROCKCHIP=y
+CONFIG_SYS_MMCSD_RAW_MODE_U_BOOT_SECTOR=0x200
 CONFIG_SPL_GPIO=y
 CONFIG_SF_DEFAULT_SPEED=24000000
 CONFIG_SF_DEFAULT_MODE=0x2000
```
